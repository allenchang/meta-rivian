## conf/layer.conf
```bitbake
# We have a conf and classes directory, add to BBPATH
BBPATH .= ":${LAYERDIR}"

# We have recipes-* directories, add to BBFILES
BBFILES += "${LAYERDIR}/recipes-*/*/*.bb \
            ${LAYERDIR}/recipes-*/*/*.bbappend"

BBFILE_COLLECTIONS += "meta-rivian"
BBFILE_PATTERN_meta-rivian = "^${LAYERDIR}/"
BBFILE_PRIORITY_meta-rivian = "15"

LAYERDEPENDS_meta-rivian = "core"
LAYERSERIES_COMPAT_meta-rivian = "thud"
```
